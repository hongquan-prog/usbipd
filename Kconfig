## Kconfig
```kconfig
# USBIP Server Kconfig Configuration
#
# This file defines the configuration options for the USBIP Server
# Similar to Linux kernel Kconfig

mainmenu "USBIP Server Configuration"

#============================================================================
# Server Configuration
#============================================================================

menu "Server Configuration"

config USBIP_SERVER_PORT
    int "Server listen port"
    default 3240
    help
        The TCP port for the USBIP server to listen on.
        Default is 3240 (standard USBIP port).

        Example:
            To change to port 3241:
                CONFIG_USBIP_SERVER_PORT=3241

endmenu

#============================================================================
# URB Queue Configuration
#============================================================================

menu "URB Queue Configuration"

config USBIP_URB_QUEUE_SIZE
    int "URB queue slots per connection"
    default 8
    range 4 64
    help
        Number of URB slots in the per-connection queue.

        Each connection has its own URB queue for buffering requests
        between the RX thread and the processor thread.

        Larger values improve throughput but consume more memory.
        For high-latency networks, increase this value.

        Memory impact: sizeof(urb_slot) * USBIP_URB_QUEUE_SIZE per connection

config USBIP_URB_DATA_MAX_SIZE
    int "Maximum URB data size (bytes)"
    default 512
    range 64 4096
    help
        Maximum data size per URB transfer.

        This value must be large enough to accommodate the largest
        endpoint buffer size of any attached USB device.

        Typical values:
        - HID devices (CMSIS-DAP v1): 64 bytes
        - Bulk devices (CMSIS-DAP v2): 512 bytes
        - High-speed bulk endpoints: 512-1024 bytes

        Note: Each URB slot allocates a buffer of this size,
        so larger values significantly increase memory usage.

        Memory impact: USBIP_URB_DATA_MAX_SIZE * USBIP_URB_QUEUE_SIZE per connection

config USBIP_MAX_CONNECTIONS
    int "Maximum simultaneous device connections"
    default 4
    range 1 16
    help
        Maximum number of USB devices that can be exported simultaneously.

        Each connection spawns two threads (RX and Processor) and
        allocates a URB queue. Increasing this value allows more
        clients to connect but consumes more system resources.

        For single-device setups (e.g., one DAP), 1-2 is sufficient.
        For multi-probe setups, increase as needed.

endmenu

#============================================================================
# Log Configuration
#============================================================================

menu "Log Configuration"

config USBIP_LOG_LEVEL
    int "Default global log level"
    default 3
    range 0 4
    help
        Default log level for all modules.
        0 = LOG_LEVEL_NONE (no output)
        1 = LOG_LEVEL_ERR  (errors only)
        2 = LOG_LEVEL_WRN  (warnings and above)
        3 = LOG_LEVEL_INF  (info and above - default)
        4 = LOG_LEVEL_DBG  (debug and above)

config MAIN_LOG_LEVEL
    int "Main module log level"
    default 3
    range 0 4

config DAP_LOG_LEVEL
    int "DAP-Link log level"
    default 3
    range 0 4

endmenu

#============================================================================
# Thread Configuration
#============================================================================

menu "Thread Configuration"

config URB_THREAD_STACK_SIZE
    int "URB thread stack size (bytes)"
    default 0
    range 0 1048576
    help
        Stack size in bytes for URB processing thread.
        
        0 = Use OS default stack size:
            - Linux: 2-8 MB (architecture dependent)
            - macOS: 512 KB
            - ESP-IDF: typically 3-8 KB
        
        For embedded platforms with limited memory, set explicit value
        like 4096 or 8192 bytes.
        
        For Linux with complex devices or debugging, may need 64KB+.

config URB_THREAD_PRIORITY
    int "URB thread priority"
    default 0
    range -10 10
    help
        Priority for URB processing thread.
        Default is 0 (normal priority).
        
        Positive values = higher priority (faster response)
        Negative values = lower priority (better system responsiveness)
        
        Note: Actual priority mapping depends on platform:
        - POSIX: mapped to nice values
        - FreeRTOS: mapped to task priority

endmenu

#============================================================================
# Debug Probe GPIO Configuration
#============================================================================

menu "Debug Probe GPIO Configuration"

config GPIO_SWCLK
    int "SWD Clock (SWCLK) GPIO pin"
    default 17
    range 0 27
    help
        GPIO pin number for SWD clock line.
        Default is 17 (Pin 11 on Raspberry Pi 5).

config GPIO_SWDIO
    int "SWD Data I/O (SWDIO) GPIO pin"
    default 27
    range 0 27
    help
        GPIO pin number for SWD data line.
        Default is 27 (Pin 13 on Raspberry Pi 5).

config GPIO_TCK
    int "JTAG Clock (TCK) GPIO pin"
    default 17
    range 0 27
    help
        GPIO pin number for JTAG clock line.
        Default is 17.

config GPIO_TMS
    int "JTAG Mode Select (TMS) GPIO pin"
    default 27
    range 0 27
    help
        GPIO pin number for JTAG mode select line.
        Default is 27.

config GPIO_TDI
    int "JTAG Data In (TDI) GPIO pin"
    default 22
    range 0 27
    help
        GPIO pin number for JTAG data input line.
        Default is 22.

config GPIO_TDO
    int "JTAG Data Out (TDO) GPIO pin"
    default 23
    range 0 27
    help
        GPIO pin number for JTAG data output line.
        Default is 23.

endmenu
```
